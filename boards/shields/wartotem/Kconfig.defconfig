## boards/shields/wartotem/Kconfig.defconfig
```kconfig
if SHIELD_WARTOTEM_LEFT

config ZMK_KEYBOARD_NAME
    default "wartotem"

config ZMK_SPLIT_ROLE_CENTRAL
    default y

config ZMK_SPLIT_BLE_CENTRAL_PERIPHERALS
  default 1

config BT_MAX_CONN
  default 6

config BT_MAX_PAIRED
  default 6

# Bump this value needed for concurrent GATT discovery of splits
config BT_L2CAP_TX_BUF_COUNT
    default 10 if ZMK_SPLIT_ROLE_CENTRAL

endif

if SHIELD_WARTOTEM_LEFT || SHIELD_WARTOTEM_RIGHT

config ZMK_SPLIT
    default y

endif
```

## boards/shields/wartotem/Kconfig.shield
```kconfig
# Copyright (c) 2022 The ZMK Contributors
# SPDX-License-Identifier: MIT


config SHIELD_WARTOTEM_LEFT
    def_bool $(shields_list_contains,wartotem_left)

config SHIELD_WARTOTEM_RIGHT
    def_bool $(shields_list_contains,wartotem_right)
```
